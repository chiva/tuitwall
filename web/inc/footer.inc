<div id="footer" class="block" style="font-size: 15px; margin-top: 40px">
	<div style="float: left; padding: 0; margin: 0; padding-right: 8px">
		Desarrollado por
		<div style="margin:0; padding-top: 6px">
			<a href="https://twitter.com/sr_chiva" class="twitter-follow-button" data-show-count="false" data-lang="es" data-width="124px">Follow @twitterapi</a>
			<script src="//platform.twitter.com/widgets.js" type="text/javascript"></script>
		</div>
	</div>
	<div style="float: left; width: 302px; padding-left: 8px; margin: 0; text-align:center; border-left: 1px solid #E6E6E6; border-right: 1px solid #E6E6E6;">
		Difunde
		<!-- AddThis Button BEGIN -->
		<div class="addthis_toolbox addthis_default_style " addthis:url='http://tuitwall.kungfulabs.com' addthis:title='tuitwall | Manda mensajes a la barra de LEDs' style="padding-top: 6px">
			<a class="addthis_button_facebook_like" fb:like:layout="button_count"></a>
			<a class="addthis_button_tweet"></a>
			<a class="addthis_button_google_plusone" g:plusone:size="medium"></a>
		</div>
		<script type="text/javascript" src="http://s7.addthis.com/js/250/addthis_widget.js#pubid=ra-4ea0761e77aedad1"></script>
		<!-- AddThis Button END -->
	</div>
	<div style="float: left; width: 97px; padding: 0; margin: 0; padding-left: 8px">
		Código fuente
		<div style="margin:0; padding-top: 4px; text-align: left">
			<a href="https://github.com/chiva/tuitwall" class="gitforked-button gitforked-forks gitforked-watchers">Fork</a>
			<script src="http://gitforked.com/api/1.1/button.js" type="text/javascript"></script>
		</div>
	</div>
</div>