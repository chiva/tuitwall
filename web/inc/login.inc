<form action="redirect.php" method="post">
	<div id="login" class="block" style="padding-top: 0px;">
		<div style="clear: both; padding-top: 15px; padding-bottom: 15px;"><strong>Which tweets would you like to show?</strong></div>
		<div style="float: left; padding-right: 15px; margin: 0; text-align: left; border-right: 1px solid #E6E6E6;">
			<input type="radio" name="tweet" value="timeline" checked="checked" />Timeline<br />
			<input type="radio" name="tweet" value="mentions" />Mentions<br />
			<input type="radio" name="tweet" value="own" />Own<br />
		</div>
		<div style="float: center; margin: 0;">
			<input type="image" src="images/sign-in-with-twitter-gray.png" style="padding-top: 20px">
		</div>
	</div>
</form>